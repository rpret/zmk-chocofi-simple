## config/west.yml
```yaml
manifest:
  remotes:
    - name: zmkfirmware
      url-base: https://github.com/zmkfirmware
    - name: m165437 
      url-base: https://github.com/M165437 
    - name: urob
      url-base: https://github.com/urob
  projects:
    - name: zmk
      remote: zmkfirmware
      revision: main
      import: app/west.yml
    - name: nice-view-gem 
      remote: m165437 
      revision: main 
    - name: zmk-helpers
      remote: urob
      revision: main
    - name: zmk-auto-layer
      revision: main
      path: modules/auto-layer
    - name: zmk-tri-state
      revision: main
      path: modules/tri-state
  self:
    path: config
```
